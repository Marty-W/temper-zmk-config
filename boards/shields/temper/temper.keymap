/*
 * Copyright (c) 2024 The ZMK Contributors
 *
 * SPDX-License-Identifier: MIT
 */

/* Includes */
#include <behaviors.dtsi>
#include <behaviors/num_word.dtsi>
#include <dt-bindings/zmk/keys.h>
#include <dt-bindings/zmk/bt.h>

#include <dt-bindings/zmk/bt.h>
#include <dt-bindings/zmk/outputs.h>
/* Wireless Configuration */

/* Helper Includes */
#include "zmk-helpers/helper.h"
#include "zmk-helpers/key-labels/36.h"

/* Layer Definitions */
#define DEF 0
#define NAV 1
#define FN 2
#define NUM 3
#define SYS 4
#define MOUSE 5

/* Basic Definitions */
#define XXX &none
#define ___ &trans
#define QUICK_TAP_MS 175

/* Desktop Management Keys */
#define DSK_PREV &kp LG(LC(LEFT))   // Previous desktop
#define DSK_NEXT &kp LG(LC(RIGHT))  // Next desktop
#define DSK_MGR &kp LG(TAB)         // Desktop manager
#define PIN_APP &kp LG(LC(F))       // Pin application
#define PIN_WIN &kp LG(LC(W))       // Pin window
#define VOL_DOWN &kp C_VOL_DN       // Volume down

/* Hyper Key Configuration */
#define HYPER LS(LC(LA(LGUI)))
ZMK_BEHAVIOR(hyper_key, hold_tap,
    flavor = "balanced";
    tapping-term-ms = <200>;
    quick-tap-ms = <QUICK_TAP_MS>;
    bindings = <&kp>, <&kp>;
)

/* Global Behavior Settings */
&sk {
    release-after-ms = <900>;
    quick-release;
};

&sl {
    ignore-modifiers;
};

&lt {
    flavor = "balanced";
    tapping-term-ms = <200>;
    quick-tap-ms = <QUICK_TAP_MS>;
};

/* Home Row Mods Configuration */
#define KEYS_L LT0 LT1 LT2 LT3 LT4 LM0 LM1 LM2 LM3 LM4 LB0 LB1 LB2 LB3 LB4
#define KEYS_R RT0 RT1 RT2 RT3 RT4 RM0 RM1 RM2 RM3 RM4 RB0 RB1 RB2 RB3 RB4
#define THUMBS LH2 LH1 LH0 RH0 RH1 RH2

/* Mask Mods Helper */
#define MASK_MODS(NAME, MODS, BINDING) \
    ZMK_BEHAVIOR(NAME, mod_morph, \
        mods = <MODS>; \
        bindings = <BINDING>, <BINDING>; \
    )

ZMK_BEHAVIOR(hml, hold_tap,
    flavor = "balanced";
    tapping-term-ms = <280>;
    quick-tap-ms = <QUICK_TAP_MS>;
    require-prior-idle-ms = <150>;
    hold-trigger-on-release;
    hold-trigger-key-positions = <RT0 RT1 RT2 RT3 RT4 RM0 RM1 RM2 RM3 RM4 RB0 RB1 RB2 RB3 RB4 LH2 LH1 LH0 RH0 RH1 RH2>;
    bindings = <&kp>, <&kp>;
)

ZMK_BEHAVIOR(hmr, hold_tap,
    flavor = "balanced";
    tapping-term-ms = <280>;
    quick-tap-ms = <QUICK_TAP_MS>;
    require-prior-idle-ms = <150>;
    hold-trigger-on-release;
    hold-trigger-key-positions = <LT0 LT1 LT2 LT3 LT4 LM0 LM1 LM2 LM3 LM4 LB0 LB1 LB2 LB3 LB4 LH2 LH1 LH0 RH0 RH1 RH2>;
    bindings = <&kp>, <&kp>;
)

/* Combo Configuration */
/* Define a custom combo with home row mod functionality */
#define ZMK_COMBO_8(NAME, TAP, POS, LAYERS, COMBO_MS, IDLE_MS, HOLD, SIDE) \
    ZMK_BEHAVIOR(hm_combo_##NAME, hold_tap, \
        flavor = "balanced"; \
        tapping-term-ms = <280>; \
        quick-tap-ms = <QUICK_TAP_MS>; \
        require-prior-idle-ms = <150>; \
        hold-trigger-on-release; \
        hold-trigger-key-positions = <LT0 LT1 LT2 LT3 LT4 LM0 LM1 LM2 LM3 LM4 LB0 LB1 LB2 LB3 LB4 RT0 RT1 RT2 RT3 RT4 RM0 RM1 RM2 RM3 RM4 RB0 RB1 RB2 RB3 RB4 LH2 LH1 LH0 RH0 RH1 RH2>; \
        bindings = <&kp>, <TAP>; \
    ) \
    ZMK_COMBO_6(NAME, &hm_combo_##NAME HOLD 0, POS, LAYERS, COMBO_MS, IDLE_MS)

#include "combos.dtsi"

/* Navigation Configuration */
#define MT_CORE                        \
    flavor = "tap-preferred";         \
    tapping-term-ms = <220>;          \
    quick-tap-ms = <220>;             \
    hold-trigger-key-positions = <0>;

&mt { MT_CORE };

ZMK_HOLD_TAP(mt_home, bindings = <&masked_home>, <&kp>; MT_CORE)
ZMK_HOLD_TAP(mt_end, bindings = <&masked_end>, <&kp>; MT_CORE)

#define NAV_LEFT  &mt_home 0   LEFT
#define NAV_RIGHT &mt_end 0    RIGHT
#define NAV_UP    &mt LC(HOME) UP
#define NAV_DOWN  &mt LC(END)  DOWN
#define NAV_BSPC &lt NAV BSPC
#define NAV_DEL   &mt LC(DEL)  DEL

MASK_MODS(masked_home, (MOD_LCTL), &kp HOME)
MASK_MODS(masked_end,  (MOD_LCTL), &kp END)


/* Smart Layer Configuration */
#define SMART_NUM &smart_num NUM 0
ZMK_HOLD_TAP(smart_num, bindings = <&mo>, <&num_dance>; flavor = "balanced";
             tapping-term-ms = <200>; quick-tap-ms = <QUICK_TAP_MS>;)

ZMK_TAP_DANCE(num_dance, bindings = <&num_word NUM>, <&sl NUM>;
              tapping-term-ms = <200>;)

/* Mouse Configuration */
ZMK_TRI_STATE(
    smart_mouse, bindings = <&tog MOUSE>, <&none>, <&tog MOUSE>;
    ignored-key-positions =
        <LT1 LT2 LH0 LH1 RT1 RT2 RT3 RM0 RM1 RM2 RM3 RM4 RB1 RB2 RB3 RH0 RH1>;
    ignored-layers = <MOUSE NAV FN>;
)

/* Custom Behaviors */
#define SIMPLE_MORPH(NAME, MOD, BINDING1, BINDING2) \
    ZMK_MOD_MORPH(NAME, \
        mods = <(MOD_L##MOD | MOD_R##MOD)>; \
        bindings = <BINDING1>, <BINDING2>; \
    )

SIMPLE_MORPH(comma_morph, SFT, &kp COMMA, &comma_inner_morph)
SIMPLE_MORPH(comma_inner_morph, CTL, &kp SEMICOLON, &kp LESS_THAN)

SIMPLE_MORPH(dot_morph, SFT, &kp DOT, &dot_inner_morph)
SIMPLE_MORPH(dot_inner_morph, CTL, &kp COLON, &kp GREATER_THAN)

SIMPLE_MORPH(qexcl, SFT, &kp QMARK, &kp EXCL)
SIMPLE_MORPH(lpar_lt, SFT, &kp LPAR, &kp LT)
SIMPLE_MORPH(rpar_gt, SFT, &kp RPAR, &kp GT)

/* Space and Backspace Behaviors */
ZMK_HOLD_TAP(lt_spc, bindings = <&mo>, <&spc_morph>; flavor = "balanced";
             tapping-term-ms = <200>; quick-tap-ms = <QUICK_TAP_MS>;)

SIMPLE_MORPH(spc_morph, SFT, &kp SPACE, &dot_spc)

ZMK_MACRO(dot_spc,
    bindings = <&kp DOT &kp SPACE &sk LSHFT>;
    wait-ms = <0>;
    tap-ms = <5>;
)

ZMK_MOD_MORPH(bs_del,
    bindings = <&kp BSPC>, <&kp DEL>;
    mods = <(MOD_LSFT|MOD_RSFT)>;
    keep-mods = <MOD_RSFT>;
)

/* Copy and Leader Behaviors */
ZMK_TAP_DANCE(copy_cut, bindings = <&kp LC(INS)>, <&kp LC(X)>;
              tapping-term-ms = <200>;)

#define CANCEL &kp K_CANCEL

/* Conditional Layer */
ZMK_CONDITIONAL_LAYER(sys, NAV NUM, SYS)

/* Layer Helper */
#ifndef ZMK_BASE_LAYER
    #define ZMK_BASE_LAYER(name, LT, RT, LM, RM, LB, RB, LH, RH) \
        ZMK_LAYER(name, LT RT LM RM LB RB LH RH)
#endif

/* Consolidated Macros */
#define MAKE_HARPOON(NUMBER) \
    ZMK_MACRO(nv_harp##NUMBER, \
        wait-ms = <0>; \
        tap-ms = <0>; \
        bindings = <&kp SPACE &kp N##NUMBER>; \
    )

MAKE_HARPOON(1)
MAKE_HARPOON(2)
MAKE_HARPOON(3)
MAKE_HARPOON(4)
MAKE_HARPOON(5)
MAKE_HARPOON(6)

#define MAKE_HYPER_NUM(NUMBER) \
    ZMK_MACRO(hyper_##NUMBER, \
        wait-ms = <0>; \
        tap-ms = <0>; \
        bindings = <&macro_press &kp LSHFT &kp LCTRL &kp LALT &kp LGUI>, \
                  <&macro_tap &kp N##NUMBER>, \
                  <&macro_release &kp LSHFT &kp LCTRL &kp LALT &kp LGUI>; \
    )

MAKE_HYPER_NUM(1)
MAKE_HYPER_NUM(2)
MAKE_HYPER_NUM(3)
MAKE_HYPER_NUM(4)
MAKE_HYPER_NUM(5)

/* Custom Mac Keycodes */
#define MAC_SLEEP   &kp LG(LC(Q))       // Command + Control + Q
#define MAC_RESTART &kp LG(LC(LS(Q)))   // Command + Control + Shift + Q
#define SEL_ALL     &kp LG(A)           // Command + A
#define SEL_LINE    &kp LG(LS(LEFT))    // Command + Shift + Left
#define SEL_WORD    &kp LA(LS(LEFT))    // Option + Shift + Left
#define FIND_NEXT   &kp LG(G)           // Command + G
#define FIND_PREV   &kp LG(LS(G))       // Command + Shift + G
#define DEL_WORD    &kp LA(BSPC)        // Option + Backspace
#define DEL_LINE    &kp LG(BSPC)        // Command + Backspace
#define DOC_HOME    &kp LG(UP)          // Command + Up
#define DOC_END     &kp LG(DOWN)        // Command + Down
#define SCRN_SHOT   &kp LG(LS(N4))      // Command + Shift + 4

/* Layer Definitions */

ZMK_BASE_LAYER(Base,
//╭─────────────┬─────────────┬─────────────┬─────────────┬─────────────╮ ╭─────────────┬─────────────┬─────────────┬─────────────┬─────────────╮
    &bt BT_CLR     &bt BT_CLR_ALL    &bootloader         &sys_reset         &out OUT_TOG        ,   &kp Y         &kp U         &kp I         &kp O         &kp P     ,
//├─────────────┼─────────────┼─────────────┼─────────────┼─────────────┤ ├─────────────┼─────────────┼─────────────┼─────────────┼─────────────┤
    &hml LALT A   &hml LGUI S   &hml LCTRL D   &hml LSHIFT F  &kp G      ,   &kp H         &hmr LSHIFT J &hmr LCTRL K  &hmr LGUI L   &hmr LALT SEMI,
//├─────────────┼─────────────┼─────────────┼─────────────┼─────────────┤ ├─────────────┼─────────────┼─────────────┼─────────────┼─────────────┤
    &kp Z         &kp X         &kp C         &kp V         &kp B      ,   &kp N         &kp M         &comma_morph  &dot_morph    &qexcl      ,
//╰─────────────┼─────────────┴─────────────┼─────────────┼─────────────┼─────────────┤ ├─────────────┼─────────────┼─────────────┼─────────────╯
                                              SMART_NUM     NAV_BSPC      &lt NAV ESC   ,   &kp ENTER     &kp SPACE     &kp HYPER
//                                          ╰─────────────┴─────────────┴─────────────╯ ╰─────────────┴─────────────┴─────────────╯
)

ZMK_BASE_LAYER(Nav,
//╭─────────────┬─────────────┬─────────────┬─────────────┬─────────────╮ ╭─────────────┬─────────────┬─────────────┬─────────────┬─────────────╮
    &kp C_BRI_DN  &kp C_BRI_UP  &kp C_PREV   &kp C_PP     &kp C_NEXT   ,  MAC_SLEEP     &nv_harp1     &nv_harp2     &nv_harp3     &nv_harp4    ,
//├─────────────┼─────────────┼─────────────┼─────────────┼─────────────┤ ├─────────────┼─────────────┼─────────────┼─────────────┼─────────────┤
    &hyper_1      &hyper_2      &hyper_3      &hyper_4     &hyper_5     ,  &kp LEFT      &kp DOWN      &kp UP        &kp RIGHT     &kp RCTRL    ,
//├─────────────┼─────────────┼─────────────┼─────────────┼─────────────┤ ├─────────────┼─────────────┼─────────────┼─────────────┼─────────────┤
    DEL_WORD      DEL_LINE      DOC_HOME      DOC_END      SCRN_SHOT    ,  &kp HOME      &kp PG_DN     &kp PG_UP     &kp END       &kp LC(Z)    ,
//╰─────────────┼─────────────┴─────────────┼─────────────┼─────────────┼─────────────┤ ├─────────────┼─────────────┼─────────────┼─────────────╯
                                              ___           ___           ___          ,  &kp C_MUTE    &kp C_VOL_DN  &kp C_VOL_UP
//                                          ╰─────────────┴─────────────┴─────────────╯ ╰─────────────┴─────────────┴─────────────╯
)

ZMK_BASE_LAYER(Num,
//╭─────────────┬─────────────┬─────────────┬─────────────┬─────────────╮ ╭─────────────┬─────────────┬─────────────┬─────────────┬─────────────╮
    &kp PLUS      &kp MINUS     &kp STAR      &kp FSLH     &kp EQUAL    ,   ___           &kp N7        &kp N8        &kp N9        &kp BSPC    ,
//├─────────────┼─────────────┼─────────────┼─────────────┼─────────────┤ ├─────────────┼─────────────┼─────────────┼─────────────┼─────────────┤
    &kp DLLR      &kp PRCNT     &kp CARET     &kp DOT      &kp COMMA    ,   ___           &kp N4        &kp N5        &kp N6        &kp DOT     ,
//├─────────────┼─────────────┼─────────────┼─────────────┼─────────────┼─────────────┤ ├─────────────┼─────────────┼─────────────┼─────────────┼─────────────┤
    &kp HASH      &kp AT        &kp AMPS      &kp UNDER    &kp TILDE    ,   ___           &kp N1        &kp N2        &kp N3        &kp RET     ,
//╰─────────────┼─────────────┴─────────────┼─────────────┼─────────────┼─────────────┤ ├─────────────┼─────────────┼─────────────┼─────────────╯
                                              ___           ___           ___           ,   &kp COMMA     &kp N0        &kp DOT
//                                          ╰─────────────┴─────────────┴─────────────╯ ╰─────────────┴─────────────┴─────────────╯
)

ZMK_BASE_LAYER(Sys,
//╭─────────────┬─────────────┬─────────────┬─────────────┬─────────────╮ ╭─────────────┬─────────────┬─────────────┬─────────────┬─────────────╮
    ___           ___           ___           ___           ___         ,   &bt BT_SEL 0 &bt BT_SEL 1 &bt BT_SEL 2 &bt BT_SEL 3 &bt BT_CLR         ,
//├─────────────┼─────────────┼─────────────┼─────────────┼─────────────┤ ├─────────────┼─────────────┼─────────────┼─────────────┼─────────────┤
    ___           ___           ___           ___           &bootloader ,   &bootloader   &out OUT_TOG  &out OUT_USB  &out OUT_BLE  &out OUT_USB         ,
//├─────────────┼─────────────┼─────────────┼─────────────┼─────────────┤ ├─────────────┼─────────────┼─────────────┼─────────────┼─────────────┤
    ___           ___           ___           ___           &sys_reset  ,   &sys_reset    &bt BT_CLR_ALL  &bt BT_CLR   &bt BT_SEL 0  &bt BT_SEL 1         ,
//╰─────────────┼─────────────┴─────────────┼─────────────┼─────────────┼─────────────┤ ├─────────────┼─────────────┼─────────────┼─────────────╯
                               ___           ___           ___           ,   ___           ___           ___
//                           ╰─────────────┴─────────────┴─────────────╯ ╰─────────────┴─────────────┴─────────────╯
)

/* Replace hyper macros */
ZMK_MACRO(hyper_1,
    wait-ms = <0>;
    tap-ms = <0>;
    bindings = <&macro_press &kp LSHFT &kp LCTRL &kp LALT &kp LGUI>,
               <&macro_tap &kp N1>,
               <&macro_release &kp LSHFT &kp LCTRL &kp LALT &kp LGUI>;
)

ZMK_MACRO(hyper_2,
    wait-ms = <0>;
    tap-ms = <0>;
    bindings = <&macro_press &kp LSHFT &kp LCTRL &kp LALT &kp LGUI>,
               <&macro_tap &kp N2>,
               <&macro_release &kp LSHFT &kp LCTRL &kp LALT &kp LGUI>;
)

ZMK_MACRO(hyper_3,
    wait-ms = <0>;
    tap-ms = <0>;
    bindings = <&macro_press &kp LSHFT &kp LCTRL &kp LALT &kp LGUI>,
               <&macro_tap &kp N3>,
               <&macro_release &kp LSHFT &kp LCTRL &kp LALT &kp LGUI>;
)

ZMK_MACRO(hyper_4,
    wait-ms = <0>;
    tap-ms = <0>;
    bindings = <&macro_press &kp LSHFT &kp LCTRL &kp LALT &kp LGUI>,
               <&macro_tap &kp N4>,
               <&macro_release &kp LSHFT &kp LCTRL &kp LALT &kp LGUI>;
)

ZMK_MACRO(hyper_5,
    wait-ms = <0>;
    tap-ms = <0>;
    bindings = <&macro_press &kp LSHFT &kp LCTRL &kp LALT &kp LGUI>,
               <&macro_tap &kp N5>,
               <&macro_release &kp LSHFT &kp LCTRL &kp LALT &kp LGUI>;
)

/* Replace harp macros */
ZMK_MACRO(nv_harp1,
    wait-ms = <0>;
    tap-ms = <0>;
    bindings = <&kp SPACE>, <&kp N1>;
)

ZMK_MACRO(nv_harp2,
    wait-ms = <0>;
    tap-ms = <0>;
    bindings = <&kp SPACE>, <&kp N2>;
)

ZMK_MACRO(nv_harp3,
    wait-ms = <0>;
    tap-ms = <0>;
    bindings = <&kp SPACE>, <&kp N3>;
)

ZMK_MACRO(nv_harp4,
    wait-ms = <0>;
    tap-ms = <0>;
    bindings = <&kp SPACE>, <&kp N4>;
)